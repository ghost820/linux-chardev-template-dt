/dts-v1/;
/plugin/;

/ {
	compatible = "brcm,bcm2712";

	fragment@0 {
		target-path = "/";
		__overlay__ {
			chardev: chardev {
				compatible = "chardev";
				ghost,someprop = "";
			};
		};
	};
};
